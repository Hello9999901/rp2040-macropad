## config/boards/shields/macropad/Kconfig.defconfig
```kconfig
if SHIELD_MACROPAD

config ZMK_KEYBOARD_NAME
    default "EEC RP2040 Macropad"

if ZMK_BACKLIGHT

config PWM
    default y

config LED_PWM
    default y

endif # ZMK_BACKLIGHT

endif
```
